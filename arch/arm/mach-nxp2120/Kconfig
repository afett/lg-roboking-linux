## arch/arm/mach-nxp2120/Kconfig
```kconfig
# arch/arm/mach-nxp2120/Kconfig
#
# Copyright(c) 2011 MOSTiTECH co., ltd.
#
# Configuration options for the nxp2120 CPU

config CPU_NXP2120
        bool "Nexell's P2120 SOC CPU"
        depends on PLAT_NEXELL
        select CPU_V6
        select GENERIC_TIME
        help
           Enable NXP2120 CPU support

config MACH_MOST2120
        bool "mostitech nxp2120 board"
        depends on CPU_NXP2120
        help
           Machine support for the MOSTiTECH's nxp2120 board

choice
        prompt "Model name"
        depends on MACH_MOST2120

config MODEL_RKSII_CI
        bool "LG RKSII CI"
        depends on MACH_MOST2120

config MODEL_RKSII_VR
        bool "LG RKSII VR"
        depends on MACH_MOST2120

config MODEL_RKSII_VR_FEMALE
        bool "LG RKSII VR FEMALE"
        depends on MACH_MOST2120

config MODEL_RKSII_VR_MALE
        bool "LG RKSII VR MALE"
        depends on MACH_MOST2120

config MODEL_RKSII_VI
        bool "LG RKSII VI"
        depends on MACH_MOST2120

config MODEL_RKN
        bool "LG RK Network"
        depends on MACH_MOST2120

config MODEL_RK_HIT_V2
        bool "LG RK HIT V2"
        depends on MACH_MOST2120

config MODEL_RK_HIT_V4
        bool "LG RK HIT V4"
        depends on MACH_MOST2120

config MODEL_RK_HIT_3DSENS
        bool "LG RK HIT 3D Sensing"
        depends on MACH_MOST2120
endchoice

config MOST2120_UBIFS_DATA
        bool "MOST2120 Another data partition"
        depends on MACH_MOST2120
        help
          Another data partion is implemented for future use.
```

## arch/arm/plat-nexell/Kconfig
```kconfig
#
# Copyright 2011 mostitech.
#
# Configuration options for the Nexell board

config PLAT_NEXELL
	bool "NEXELL architecture"
	depends on ARCH_NEXELL
	default y
	help
  	   Nexell's SOC support code.
```

## drivers/media/video/nexell/Kconfig
```kconfig
#
# Copyright 2010 Nexell.
#
# Configuration options for the Nexell VIP SoC

comment "Decoder chips on board"

config VIDEO_DEC_TVP5150
		tristate "Texas Instruments TVP5150 video decoder"
		depends on VIDEO_V4L2 && I2C
		---help---
	  	Support for the Texas Instruments TVP5150 video decoder.

	  	To compile this driver as a module, choose M here: the
	  	module will be called tvp5150.

comment "V4L2 driver for Nexell"

config V4L2_DRIVER_NEXELL
	    tristate "V4L2 Drivers for NXP2120"
	    depends on VIDEO_V4L2 && I2C
	    --help---
	    Support for V4L2 driver for NXP2120 VIP port.

config V4L2_DRIVER_NEXELL_MODULE0
	bool "V4L2 Module 0"
	depends on V4L2_DRIVER_NEXELL
	default y

config V4L2_DRIVER_NEXELL_MODULE1
	bool "V4L2 Module 1"
	depends on V4L2_DRIVER_NEXELL
	default n

source "drivers/media/video/nexell/Kconfig-camera"
```

## sound/soc/nexell/Kconfig
```kconfig
#
# Copyright 2010 Nexell.
#
# Configuration options for the Nexell Sound

config SND_NEXELL_SOC
	tristate "Nexell SoC Audio (NX series)"
	depends on ARCH_NEXELL
	help
	  Say Y or M if you want to add support for codecs attached to
	  the AC97 and I2S interface.

config SND_NEXELL_SOC_I2S
	tristate

config SND_NEXELL_SOC_AC97
	tristate
	
config SND_NEXELL_SOC_SPDIF
	tristate

config SND_CODEC_CS42L52
	tristate "cs42l52 I2S audio codec."
	select SND_NEXELL_SOC_I2S
	select SND_SOC_CS42L52

config SND_CODEC_RT5623
	tristate "rt5623 (Realtek) I2S audio codec."
	select SND_NEXELL_SOC_I2S
	select SND_SOC_RT5623

config SND_CODEC_PS8738_8106
	tristate "Pulsus ps8738(ADC), ps8106(DAC) I2S audio codec."
	select SND_NEXELL_SOC_I2S
	select SND_SOC_PS8738_8106
	
config SND_MOST2120_WM8960
	tristate "most2120's WM8960 I2S audio codec."
	select SND_NEXELL_SOC_I2S
	select SND_SOC_WM8960

config SND_MOST2120_AC97_TWO_WM8960
        tristate "most2120's two WM8960 AC97 audio codec."
        select SND_NEXELL_SOC_AC97
        select SND_SOC_TWO_WM8960
        
config SND_NEXELL_SPDIF_RX
        tristate "nxp2120's spdif-rx ports"
        select SND_NEXELL_SOC_SPDIF
```
